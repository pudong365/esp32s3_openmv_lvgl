## project/ksdiy/sdkconfig.defaults
```kconfig
# Flash 配置 - 16MB
CONFIG_ESPTOOLPY_FLASHSIZE_16MB=y
CONFIG_ESPTOOLPY_FLASHSIZE_8MB=n

# PSRAM 配置 - 启用 8MB Octal PSRAM
CONFIG_SPIRAM=y
CONFIG_SPIRAM_MODE_OCT=y
CONFIG_SPIRAM_SIZE=8
CONFIG_SPIRAM_BOOT_INIT=y
CONFIG_SPIRAM_USE_MALLOC=y

# deflate 压缩支持
CONFIG_MICROPY_PY_DEFLATE=y
CONFIG_MICROPY_PY_DEFLATE_COMPRESS=y
```
